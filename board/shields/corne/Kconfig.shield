## board/shields/corne/Kconfig.shield
```kconfig
# Copyright (c) 2020 Pete Johanson
# SPDX-License-Identifier: MIT

config SHIELD_YSORNE_LEFT
    def_bool $(shields_list_contains,ysorne_left)

config SHIELD_YSORNE_RIGHT
    def_bool $(shields_list_contains,ysorne_right)
```

## config/west.yml
```yaml
manifest:
  remotes:
    - name: zmk-config-corne
      url-base: https://github.com/yunsuk-jeung
      revision: test_zmk
  projects:
    - name: zmk-config-corne
      remote:  https://github.com/yunsuk-jeung
      revision: test_zmk
      import: config/west.yml
  self:
    path: config
```
